
.equ FMKEY_BREAK		= 0x5C

.equ FMKEY_PF1			= 0x5D
.equ FMKEY_PF2			= 0x5E
.equ FMKEY_PF3			= 0x5F
.equ FMKEY_PF4			= 0x60
.equ FMKEY_PF5			= 0x61

.equ FMKEY_PF6			= 0x62
.equ FMKEY_PF7			= 0x63
.equ FMKEY_PF8			= 0x64
.equ FMKEY_PF9			= 0x65
.equ FMKEY_PF10			= 0x66

.equ FMKEY_EL			= 0x49
.equ FMKEY_CLS			= 0x4A
.equ FMKEY_DUP			= 0x4C
.equ FMKEY_HOME			= 0x4E

.equ FMKEY_INS			= 0x48
.equ FMKEY_DEL			= 0x4B
.equ FMKEY_UP			= 0x4D
.equ FMKEY_LEFT			= 0x4F
.equ FMKEY_DOWN			= 0x50
.equ FMKEY_RIGHT		= 0x51

.equ FMKEY_ESC			= 0x01

.equ FMKEY_1			= 0x02
.equ FMKEY_2			= 0x03
.equ FMKEY_3			= 0x04
.equ FMKEY_4			= 0x05
.equ FMKEY_5			= 0x06
.equ FMKEY_6			= 0x07
.equ FMKEY_7			= 0x08
.equ FMKEY_8			= 0x09
.equ FMKEY_9			= 0x0A
.equ FMKEY_0			= 0x0B

.equ FMKEY_MINUS		= 0x0C
.equ FMKEY_TILDE		= 0x0D
.equ FMKEY_YEN			= 0x0E
.equ FMKEY_BACKSPACE	= 0x0F

.equ FMKEY_TAB			= 0x10

.equ FMKEY_Q			= 0x11
.equ FMKEY_W			= 0x12
.equ FMKEY_E			= 0x13
.equ FMKEY_R			= 0x14
.equ FMKEY_T			= 0x15
.equ FMKEY_Y			= 0x16
.equ FMKEY_U			= 0x17
.equ FMKEY_I			= 0x18
.equ FMKEY_O			= 0x19
.equ FMKEY_P			= 0x1A

.equ FMKEY_AT			= 0x1B
.equ FMKEY_LBR			= 0x1C
.equ FMKEY_RETURN		= 0x1D

.equ FMKEY_CTRL			= 0x52

.equ FMKEY_A			= 0x1E
.equ FMKEY_S			= 0x1F
.equ FMKEY_D			= 0x20
.equ FMKEY_F			= 0x21
.equ FMKEY_G			= 0x22
.equ FMKEY_H			= 0x23
.equ FMKEY_J			= 0x24
.equ FMKEY_K			= 0x25
.equ FMKEY_L			= 0x26

.equ FMKEY_SEMICOLON	= 0x27
.equ FMKEY_COLON		= 0x28
.equ FMKEY_RBR			= 0x29

.equ FMKEY_LSHIFT		= 0x53

.equ FMKEY_Z			= 0x2A
.equ FMKEY_X			= 0x2B
.equ FMKEY_C			= 0x2C
.equ FMKEY_V			= 0x2D
.equ FMKEY_B			= 0x2E
.equ FMKEY_N			= 0x2F
.equ FMKEY_M			= 0x30

.equ FMKEY_COMMA		= 0x31
.equ FMKEY_PERIOD		= 0x32
.equ FMKEY_SLASH		= 0x33
.equ FMKEY_QUOTES		= 0x34

.equ FMKEY_RSHIFT		= 0x54

.equ FMKEY_CAP			= 0x55
.equ FMKEY_GRAPH		= 0x56
.equ FMKEY_SPACEL		= 0x57
.equ FMKEY_SPACEC		= 0x58
.equ FMKEY_SPACER		= 0x35
.equ FMKEY_KANA			= 0x5A

.equ FMKEY_KP_MUL		= 0x36
.equ FMKEY_KP_DIV		= 0x37
.equ FMKEY_KP_PLUS		= 0x38
.equ FMKEY_KP_MINUS		= 0x39
.equ FMKEY_KP_EQUAL		= 0x3D
.equ FMKEY_KP_COMMA		= 0x41
.equ FMKEY_KP_ENTER		= 0x45
.equ FMKEY_KP_0			= 0x47
.equ FMKEY_KP_1			= 0x42
.equ FMKEY_KP_2			= 0x43
.equ FMKEY_KP_3			= 0x44
.equ FMKEY_KP_4			= 0x3E
.equ FMKEY_KP_5			= 0x3F
.equ FMKEY_KP_6			= 0x40
.equ FMKEY_KP_7			= 0x3A
.equ FMKEY_KP_8			= 0x3B
.equ FMKEY_KP_9			= 0x3C
.equ FMKEY_KP_DOT		= 0x47
