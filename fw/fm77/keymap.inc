
.include "fm77_keycodes.inc"

.equ KEY_1			= FMKEY_1
.equ KEY_2			= FMKEY_2
.equ KEY_3			= FMKEY_3
.equ KEY_4			= FMKEY_4
.equ KEY_5			= FMKEY_5
.equ KEY_6			= FMKEY_6
.equ KEY_7			= FMKEY_7
.equ KEY_8			= FMKEY_8
.equ KEY_9			= FMKEY_9
.equ KEY_0			= FMKEY_0

.equ KEY_Q			= FMKEY_Q
.equ KEY_W			= FMKEY_W
.equ KEY_E			= FMKEY_E
.equ KEY_R			= FMKEY_R
.equ KEY_T			= FMKEY_T
.equ KEY_Y			= FMKEY_Y
.equ KEY_U			= FMKEY_U
.equ KEY_I			= FMKEY_I
.equ KEY_O			= FMKEY_O
.equ KEY_P			= FMKEY_P

.equ KEY_A			= FMKEY_A
.equ KEY_S			= FMKEY_S
.equ KEY_D			= FMKEY_D
.equ KEY_F			= FMKEY_F
.equ KEY_G			= FMKEY_G
.equ KEY_H			= FMKEY_H
.equ KEY_J			= FMKEY_J
.equ KEY_K			= FMKEY_K
.equ KEY_L			= FMKEY_L

.equ KEY_Z			= FMKEY_Z
.equ KEY_X			= FMKEY_X
.equ KEY_C			= FMKEY_C
.equ KEY_V			= FMKEY_V
.equ KEY_B			= FMKEY_B
.equ KEY_N			= FMKEY_N
.equ KEY_M			= FMKEY_M

.equ KEY_COMMA		= FMKEY_COMMA
.equ KEY_PERIOD		= FMKEY_PERIOD
.equ KEY_TILDE		= FMKEY_ESC 
.equ KEY_MINUS		= FMKEY_MINUS
.equ KEY_EQUAL		= FMKEY_TILDE
.equ KEY_BRL		= FMKEY_LBR
.equ KEY_BRR		= FMKEY_RBR
.equ KEY_SEMICOLON	= FMKEY_SEMICOLON
.equ KEY_APOS		= FMKEY_COLON
.equ KEY_SLASH		= FMKEY_SLASH
.equ KEY_BSLASH		= FMKEY_YEN

.equ KEY_ENTER		= FMKEY_RETURN
.equ KEY_ESC		= FMKEY_BREAK
.equ KEY_SPACE		= FMKEY_SPACEC
.equ KEY_BACKSPACE	= FMKEY_BACKSPACE
.equ KEY_TAB		= FMKEY_TAB
.equ KEY_INSERT		= FMKEY_INS
.equ KEY_DELETE		= FMKEY_DEL

.equ KEY_F1			= FMKEY_PF1
.equ KEY_F2			= FMKEY_PF2
.equ KEY_F3			= FMKEY_PF3
.equ KEY_F4			= FMKEY_PF4
.equ KEY_F5			= FMKEY_PF5
.equ KEY_F6			= FMKEY_PF6
.equ KEY_F7			= FMKEY_PF7
.equ KEY_F8			= FMKEY_PF8
.equ KEY_F9			= FMKEY_PF9
.equ KEY_F10		= FMKEY_PF10
.equ KEY_F11		= FMKEY_AT
.equ KEY_F12		= FMKEY_QUOTES

.equ KEY_CTRL		= FMKEY_CTRL
.equ KEY_LSHIFT		= FMKEY_LSHIFT
.equ KEY_RSHIFT		= FMKEY_RSHIFT
.equ KEY_ALT		= FMKEY_GRAPH
.equ KEY_CAPS		= FMKEY_CAP
.equ KEY_LGUI		= FMKEY_SPACEL
.equ KEY_RGUI		= FMKEY_SPACER
.equ KEY_APPS		= FMKEY_KANA

.equ KEY_UP			= FMKEY_UP
.equ KEY_DOWN		= FMKEY_DOWN
.equ KEY_LEFT		= FMKEY_LEFT
.equ KEY_RIGHT		= FMKEY_RIGHT
.equ KEY_HOME		= FMKEY_HOME
.equ KEY_END		= FMKEY_CLS
.equ KEY_PAGEUP		= FMKEY_EL
.equ KEY_PAGEDOWN	= FMKEY_DUP

.equ KEY_NUMLOCK	= FMKEY_KP_EQUAL
.equ KEY_KP_0		= FMKEY_KP_0
.equ KEY_KP_1		= FMKEY_KP_1
.equ KEY_KP_2		= FMKEY_KP_2
.equ KEY_KP_3		= FMKEY_KP_3
.equ KEY_KP_4		= FMKEY_KP_4
.equ KEY_KP_5		= FMKEY_KP_5
.equ KEY_KP_6		= FMKEY_KP_6
.equ KEY_KP_7		= FMKEY_KP_7
.equ KEY_KP_8		= FMKEY_KP_8
.equ KEY_KP_9		= FMKEY_KP_9
.equ KEY_KP_DOT		= FMKEY_KP_DOT
.equ KEY_KP_MUL		= FMKEY_KP_MUL
.equ KEY_KP_PLUS	= FMKEY_KP_PLUS
.equ KEY_KP_MINUS	= FMKEY_KP_MINUS
.equ KEY_KP_DIV		= FMKEY_KP_DIV

.include "ps2_keymap.inc"
