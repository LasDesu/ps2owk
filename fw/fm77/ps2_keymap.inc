.equ KEY_NONE		= 0x00

keymap_base:
;				0				1				2				3				4				5				6				7
;				8				9				A				B				C				D				E				F
	.db		KEY_NONE,		KEY_F9,			KEY_NONE,		KEY_F5,			KEY_F3,			KEY_F1,			KEY_F2,			KEY_F12			; 00
	.db		KEY_NONE,		KEY_F10,		KEY_F8,			KEY_F6,			KEY_F4,			KEY_TAB,		KEY_TILDE,		KEY_NONE		; 08
	
	.db		KEY_NONE,		KEY_ALT,		KEY_LSHIFT,		KEY_NONE,		KEY_CTRL,		KEY_Q,			KEY_1,			KEY_NONE		; 10
	.db		KEY_NONE,		KEY_NONE,		KEY_Z,			KEY_S,			KEY_A,			KEY_W,			KEY_2,			KEY_LGUI		; 18
	
	.db		KEY_NONE,		KEY_C,			KEY_X,			KEY_D,			KEY_E,			KEY_4,			KEY_3,			KEY_RGUI		; 20
	.db		KEY_NONE,		KEY_SPACE,		KEY_V,			KEY_F,			KEY_T,			KEY_R,			KEY_5,			KEY_APPS		; 28
	
	.db		KEY_NONE,		KEY_N,			KEY_B,			KEY_H,			KEY_G,			KEY_Y,			KEY_6,			KEY_NONE		; 30
	.db		KEY_NONE,		KEY_NONE,		KEY_M,			KEY_J,			KEY_U,			KEY_7,			KEY_8,			KEY_NONE		; 38
	
	.db		KEY_NONE,		KEY_COMMA,		KEY_K,			KEY_I,			KEY_O,			KEY_0,			KEY_9,			KEY_NONE		; 40
	.db		KEY_NONE,		KEY_PERIOD,		KEY_SLASH,		KEY_L,			KEY_SEMICOLON,	KEY_P,			KEY_MINUS,		KEY_NONE		; 48
	
	.db		KEY_NONE,		KEY_NONE,		KEY_APOS,		KEY_NONE,		KEY_BRL,		KEY_EQUAL,		KEY_NONE,		KEY_NONE		; 50
	.db		KEY_CAPS,		KEY_RSHIFT,		KEY_ENTER,		KEY_BRR,		KEY_NONE,		KEY_BSLASH,		KEY_NONE,		KEY_NONE		; 58
	
	.db		KEY_NONE,		KEY_NONE,		KEY_NONE,		KEY_NONE,		KEY_NONE,		KEY_NONE,		KEY_BACKSPACE,	KEY_NONE		; 60
	.db		KEY_NONE,		KEY_KP_1,		KEY_NONE,		KEY_KP_4,		KEY_KP_7,		KEY_NONE,		KEY_NONE,		KEY_NONE		; 68
	
	.db		KEY_KP_0,		KEY_KP_DOT,		KEY_KP_2,		KEY_KP_5,		KEY_KP_6,		KEY_KP_8,		KEY_ESC,		KEY_NUMLOCK		; 70
	.db		KEY_F11,		KEY_KP_PLUS,	KEY_KP_3,		KEY_KP_MINUS,	KEY_KP_MUL,		KEY_KP_9,		KEY_NONE,		KEY_NONE		; 78
	
	.db		KEY_NONE,		KEY_NONE,		KEY_NONE,		KEY_F7,			KEY_NONE,		KEY_NONE,		KEY_NONE,		KEY_NONE		; 80

keymap_e0_off68:
;				0				1				2				3				4				5				6				7
;				8				9				A				B				C				D				E				F
	.db		KEY_NONE,		KEY_END,		KEY_NONE,		KEY_LEFT,		KEY_HOME,		KEY_NONE,		KEY_NONE,		KEY_NONE		; 68
	.db		KEY_INSERT,		KEY_DELETE,		KEY_DOWN,		KEY_NONE,		KEY_RIGHT,		KEY_UP,			KEY_NONE,		KEY_NONE		; 70
	.db		KEY_NONE,		KEY_NONE,		KEY_PAGEDOWN,	KEY_NONE,		KEY_NONE,		KEY_PAGEUP,		KEY_NONE,		KEY_NONE		; 78
