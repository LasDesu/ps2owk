; from X millenium emulator

table_chr_base:
; 0x00:  -- ,  ESC,    1,    2,    3,    4,    5,    6 ;
	.db 0x00, 0x1b, 0x31, 0x32, 0x33, 0x34, 0x35, 0x36
; 0x08:    7,    8,    9,    0,    -,    ^,   BS,  TAB ;
	.db 0x37, 0x38, 0x39, 0x30, 0x2d, 0x5e, 0x08, 0x09
; 0x10:    Q,    W,    E,    R,    T,    Y,    U,    I ;
	.db 0x71, 0x77, 0x65, 0x72, 0x74, 0x79, 0x75, 0x69
; 0x18:    O,    P,    @,    [,  Ent, Ctrl,    A,    S ;
	.db 0x6F, 0x70, 0x40, 0x5B, 0x0d, 0x00, 0x61, 0x73
; 0x20:    D,    F,    G,    H,    J,    K,    L,    ; ;
	.db 0x64, 0x66, 0x67, 0x68, 0x6A, 0x6b, 0x6c, 0x3b
; 0x28:    :,    全, SftL,    ],    Z,    X,    C,    V ;
	.db 0x3a, 0x00, 0x00, 0x5d, 0x7a, 0x78, 0x63, 0x76
; 0x30:    B,    N,    M,   , ,   . ,   / , SftR,   [*] ;
	.db 0x62, 0x6e, 0x6d, 0x2c, 0x2e, 0x2f, 0x00, 0x2a
; 0x38:  Alt,  SPC,  Cap,  f.1,  f.2,  f.3,  f.4,  f.5 ;
	.db 0x00, 0x20, 0x00, 0x71, 0x72, 0x73, 0x74, 0x75
; 0x40:  f.6,  f.7,  f.8,  f.9, f.10, Paus, ScrL,  [7] ;
	.db 0xec, 0xeb, 0xe2, 0xe1, 0x00, 0x13, 0x00, 0x37
; 0x48:  [8],  [9],  [-],  [4],  [5],  [6],  [+],  [1] ;
	.db 0x38, 0x39, 0x2D, 0x34, 0x35, 0x36, 0x2b, 0x31
; 0x50:  [2],  [3],  [0],  [.],  ???,  ???,  ???, f.11 ;
	.db 0x32, 0x33, 0x30, 0x2e, 0x00, 0x00, 0x00, 0x00
; 0x58: f.12,   _ ,   ¥ , RLUP, RLDN,  [=], XFER,  END ;
	.db 0x00, 0x00, 0x5c, 0x0e, 0x0f, 0x3d, 0xfe, 0x11

table_chr_shift:
; 0x00:  -- ,  ESC,   ! ,   " ,   # ,   $ ,   % ,   & ;
  	.db 0x00, 0x1b, 0x21, 0x22, 0x23, 0x24, 0x25, 0x26
; 0x08:   ' ,    (,    ),    0,    =,    `,   BS,  TAB ;
	.db 0x27, 0x28, 0x29, 0x30, 0x3d, 0x60, 0x12, 0x09
; 0x10:    Q,    W,    E,    R,    T,    Y,    U,    I ;
	.db 0x51, 0x57, 0x45, 0x52, 0x54, 0x59, 0x55, 0x49
; 0x18:    O,    P,   ‾ ,    {,  Ent, Ctrl,    A,    S ;
	.db 0x4F, 0x50, 0x7e, 0x7B, 0x0d, 0x00, 0x41, 0x53
; 0x20:    D,    F,    G,    H,    J,    K,    L,    + ;
	.db 0x44, 0x46, 0x47, 0x48, 0x4A, 0x4b, 0x4c, 0x2b
; 0x28:    :,    全, SftL,    },    Z,    X,    C,    V ;
	.db 0x2a, 0x00, 0x00, 0x7d, 0x5a, 0x58, 0x43, 0x56
; 0x30:    B,    N,    M,   < ,   > ,   / , SftR,  [*] ;
	.db 0x42, 0x4e, 0x4d, 0x3c, 0x3e, 0x3f, 0x00, 0x2a
; 0x38:  Alt,  SPC,  Cap,  f.1,  f.2,  f.3,  f.4,  f.5 ;
	.db 0x00, 0x20, 0x00, 0x76, 0x77, 0x78, 0x79, 0x7a
; 0x40:  f.6,  f.7,  f.8,  f.9, f.10, Paus, ScrL,  [7] ;
	.db 0x00, 0x00, 0x00, 0x00, 0x00, 0x03, 0x00, 0x37
; 0x48:  [8],  [9],  [-],  [4],  [5],  [6],  [+],  [1] ;
	.db 0x38, 0x39, 0x2D, 0x34, 0x35, 0x36, 0x2b, 0x31
; 0x50:  [2],  [3],  [0],  [.],  ???,  ???,  ???, f.11 ;
	.db 0x32, 0x33, 0x30, 0x2e, 0x00, 0x00, 0x00, 0x00
; 0x58: f.12,   _ ,   ¥ , RLUP, RLDN,  [=], XFER,  END ;
	.db 0x00, 0x5f, 0x7c, 0x0e, 0x0f, 0x3d, 0xfe, 0x11
	
table_chr_graph:
; 0x00:  -- ,  ESC,    1,    2,    3,    4,    5,    6 ;
	.db 0x00, 0x00, 0xf1, 0xf2, 0xf3, 0xf4, 0xf5, 0xf6
; 0x08:    7,    8,    9,    0,    -,    ^,   BS,  TAB ;
	.db 0xf7, 0xf8, 0xf9, 0xfa, 0x8c, 0x8b, 0x00, 0x00
; 0x10:    Q,    W,    E,    R,    T,    Y,    U,    I ;
	.db 0xe0, 0xe1, 0xe2, 0xe3, 0xe4, 0xe5, 0xe6, 0xe7
; 0x18:    O,    P,    @,    [,  Ent, Ctrl,    A,    S ;
	.db 0xf0, 0x8d, 0x8a, 0xfc, 0x00, 0x00, 0x7f, 0xe9
; 0x20:    D,    F,    G,    H,    J,    K,    L,    ; ;
	.db 0xea, 0xeb, 0xec, 0xed, 0xee, 0xef, 0x8e, 0x89
; 0x28:    :,    全, SftL,    ],    Z,    X,    C,    V ;
	.db 0xfd, 0x00, 0x00, 0xe8, 0x80, 0x81, 0x82, 0x83
; 0x30:    B,    N,    M,   , ,   . ,   / , SftR,   [*] ;
	.db 0x84, 0x85, 0x86, 0x87, 0x88, 0xfe, 0x00, 0x9b
; 0x38:  Alt,  SPC,  Cap,  f.1,  f.2,  f.3,  f.4,  f.5 ;
	.db 0x00, 0x00, 0x00, 0x00, 0x00, 0x00, 0x00, 0x00
; 0x40:  f.6,  f.7,  f.8,  f.9, f.10, Paus, ScrL,  [7] ;
	.db 0x00, 0x00, 0x00, 0x00, 0x00, 0x13, 0x00, 0x9a
; 0x48:  [8],  [9],  [-],  [4],  [5],  [6],  [+],  [1] ;
	.db 0x93, 0x97, 0x9c, 0x95, 0x96, 0x94, 0x9d, 0x99
; 0x50:  [2],  [3],  [0],  [.],  ???,  ???,  ???, f.11 ;
	.db 0x92, 0x98, 0x8f, 0x91, 0x00, 0x00, 0x00, 0x00
; 0x58: f.12,   _ ,   ¥ , RLUP, RLDN,  [=], XFER,  END ;
	.db 0x00, 0xff, 0xfb, 0x0e, 0x0f, 0x90, 0xfe, 0x11

table_chr_ctrl:
; 0x00:  -- ,  ESC,    1,    2,    3,    4,    5,    6 ;
	.db 0x00, 0x1b, 0x31, 0x32, 0x33, 0x34, 0x35, 0x36
; 0x08:    7,    8,    9,    0,    -,    ^,   BS,  TAB ;
	.db 0x37, 0x38, 0x39, 0x30, 0x00, 0x1e, 0x08, 0x09
; 0x10:    Q,    W,    E,    R,    T,    Y,    U,    I ;
	.db 0x11, 0x17, 0x05, 0x12, 0x14, 0x19, 0x15, 0x09
; 0x18:    O,    P,    @,    [,  Ent, Ctrl,    A,    S ;
	.db 0x0f, 0x10, 0x40, 0x1b, 0x0d, 0x00, 0x01, 0x13
; 0x20:    D,    F,    G,    H,    J,    K,    L,    ; ;
	.db 0x04, 0x06, 0x07, 0x08, 0x0a, 0x0b, 0x0c, 0x3b
; 0x28:    :,    全, SftL,    ],    Z,    X,    C,    V ;
	.db 0x3a, 0x00, 0x1c, 0x1d, 0x1a, 0x18, 0x03, 0x16
; 0x30:    B,    N,    M,   , ,   . ,   / , SftR,   [*] ;
	.db 0x02, 0x0e, 0x0d, 0x00, 0x00, 0x00, 0x00, 0x2a
; 0x38:  Alt,  SPC,  Cap,  f.1,  f.2,  f.3,  f.4,  f.5 ;
	.db 0x00, 0x00, 0x00, 0x00, 0x00, 0x00, 0x00, 0x00
; 0x40:  f.6,  f.7,  f.8,  f.9, f.10, Paus, ScrL,  [7] ;
	.db 0xec, 0xeb, 0xe2, 0xe1, 0x00, 0x03, 0x00, 0x37
; 0x48:  [8],  [9],  [-],  [4],  [5],  [6],  [+],  [1] ;
	.db 0x38, 0x39, 0x2D, 0x34, 0x35, 0x36, 0x2b, 0x31
; 0x50:  [2],  [3],  [0],  [.],  ???,  ???,  ???, f.11 ;
	.db 0x32, 0x33, 0x30, 0x2e, 0x00, 0x00, 0x00, 0x00
; 0x58: f.12,   _ ,   ¥ , RLUP, RLDN,  [=], XFER,  END ;
	.db 0x00, 0x00, 0x1c, 0x0e, 0x0f, 0x3d, 0xfe, 0x11

table_chr_kana:
; 0x00:  -- ,  ESC,  'ﾇ',   'ﾌ',  'ｱ',   'ｳ',  'ｴ',  'ｵ' ;
	.db 0x00, 0x1b, 0xc7, 0xcc, 0xb1, 0xb3, 0xb4, 0xb5
; 0x08:  'ﾔ',   'ﾕ',  'ﾖ',   'ﾜ',  'ﾎ',   'ﾍ',  BS,  TAB ;
	.db 0xd4, 0xd5, 0xd6, 0xdc, 0xce, 0xcd, 0x08, 0x09
; 0x10:  'ﾀ',   'ﾃ',  'ｲ',   'ｽ',  'ｶ',  'ﾝ',  'ﾅ',  'ﾆ' ;
	.db 0xc0, 0xc3, 0xb2, 0xbd, 0xb6, 0xdd, 0xc5, 0xc6
; 0x18:  'ﾗ',   'ｾ',  'ﾞ',  'ﾟ',  Ent, Ctrl,  'ﾁ',  'ﾄ' ;
	.db 0xd7, 0xbe, 0xde, 0xdf, 0x0d, 0x00, 0xc1, 0xc4
; 0x20:  'ｼ',   'ﾊ',  'ｷ',   'ｸ',  'ﾏ',  'ﾉ',  'ﾘ',   'ﾚ' ;
	.db 0xbc, 0xca, 0xb7, 0xb8, 0xcf, 0xc9, 0xd8, 0xda
; 0x28:  'ｹ',    全, SftL,  'ﾑ',  'ﾂ',   'ｻ',  'ｿ',  'ﾋ' ;
	.db 0xb9, 0x00, 0x00, 0xd1, 0xc2, 0xbb, 0xbf, 0xcb
; 0x30:  'ｺ',   'ﾐ',  'ﾓ',  'ﾈ',   'ﾙ',  'ﾒ' , SftR,  [*] ;
	.db 0xba, 0xd0, 0xd3, 0xc8, 0xd9, 0xd2, 0x00, 0x2a
; 0x38:  Alt,  SPC,  Cap,  f.1,  f.2,  f.3,  f.4,  f.5 ;
	.db 0x00, 0x20, 0x00, 0x71, 0x72, 0x73, 0x74, 0x75
; 0x40:  f.6,  f.7,  f.8,  f.9, f.10, Paus, ScrL,  [7] ;
	.db 0xec, 0xeb, 0xe2, 0xe1, 0x00, 0x13, 0x00, 0x37
; 0x48:  [8],  [9],  [-],  [4],  [5],  [6],  [+],  [1] ;
	.db 0x38, 0x39, 0x2D, 0x34, 0x35, 0x36, 0x2b, 0x31
; 0x50:  [2],  [3],  [0],  [.],  ???,  ???,  ???, f.11 ;
	.db 0x32, 0x33, 0x30, 0x2e, 0x00, 0x00, 0x00, 0x00
; 0x58: f.12,   _ ,   ¥ , RLUP, RLDN,  [=], XFER,  END ;
	.db 0x00, 0xdb, 0xb0, 0x0e, 0x0f, 0x3d, 0xfe, 0x11

table_chr_kanashift:
; 0x00:  -- ,  ESC,  'ﾇ',   'ﾌ',  'ｧ',   'ｩ',  'ｪ',  'ｫ' ;
	.db 0x00, 0x1b, 0xc7, 0xcc, 0xa7, 0xa9, 0xaa, 0xab
; 0x08:  'ｬ',   'ｭ',  'ｮ',   'ｦ',  'ﾎ',   'ﾍ',  BS,  TAB ;
	.db 0xac, 0xad, 0xae, 0xa6, 0xce, 0xcd, 0x12, 0x09
; 0x10:  'ﾀ',   'ﾃ',  'ｨ',   'ｽ',  'ｶ',  'ﾝ',   'ﾅ',  'ﾆ' ;
	.db 0xc0, 0xc3, 0xa8, 0xbd, 0xb6, 0xdd, 0xc5, 0xc6
; 0x18:  'ﾗ',   'ｾ',  'ﾞ',  '｢',  Ent, Ctrl,  'ﾁ',  'ﾄ' ;
	.db 0xd7, 0xbe, 0xde, 0xa4, 0x0d, 0x00, 0xc1, 0xc4
; 0x20:  'ｼ',   'ﾊ',  'ｷ',  'ｸ',   'ﾏ',  'ﾉ',  'ﾘ',  'ﾚ' ;
	.db 0xbc, 0xca, 0xb7, 0xb8, 0xcf, 0xc9, 0xd8, 0xda
; 0x28:  'ｹ',    全, SftL,  '｣',  'ｯ',  'ｻ',   'ｿ',  'ﾋ' ;
	.db 0xb9, 0x00, 0x00, 0xa3, 0xaf, 0xbb, 0xbf, 0xcb
; 0x30:  'ｺ',   'ﾐ',  'ﾓ',  '､',  '｡',  '･', SftR,  [*] ;
	.db 0xba, 0xd0, 0xd3, 0xa4, 0xa1, 0xa5, 0x00, 0x2a
; 0x38:  Alt,  SPC,  Cap,  f.1,  f.2,  f.3,  f.4,  f.5 ;
	.db 0x00, 0x20, 0x00, 0x76, 0x77, 0x78, 0x79, 0x7a
; 0x40:  f.6,  f.7,  f.8,  f.9, f.10, Paus, ScrL,  [7] ;
	.db 0x00, 0x00, 0x00, 0x00, 0x00, 0x03, 0x00, 0x37
; 0x48:  [8],  [9],  [-],  [4],  [5],  [6],  [+],  [1] ;
	.db 0x38, 0x39, 0x2D, 0x34, 0x35, 0x36, 0x2b, 0x31
; 0x50:  [2],  [3],  [0],  [.],  ???,  ???,  ???, f.11 ;
	.db 0x32, 0x33, 0x30, 0x2e, 0x00, 0x00, 0x00, 0x00
; 0x58: f.12,   _ ,   ¥ , RLUP, RLDN,  [=], XFER,  END ;
	.db 0x00, 0xdb, 0xb0, 0x0e, 0x0f, 0x3d, 0xfe, 0x11
